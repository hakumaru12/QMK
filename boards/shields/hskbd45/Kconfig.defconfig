## boards/shields/hskbd45/Kconfig.defconfig
```kconfig
if SHIELD_HSKBD45_LEFT || SHIELD_HSKBD45_RIGHT

config ZMK_KEYBOARD_NAME
    default "HSKBD45"

config ZMK_SPLIT
    default y

if SHIELD_HSKBD45_LEFT

config ZMK_SPLIT_ROLE_CENTRAL
    default y

endif # SHIELD_HSKBD45_LEFT

endif # SHIELD_HSKBD45_LEFT || SHIELD_HSKBD45_RIGHT
```

## boards/shields/hskbd45/Kconfig.shield
```kconfig
config SHIELD_HSKBD45_LEFT
    def_bool $(shields_list_contains,hskbd45_left)

config SHIELD_HSKBD45_RIGHT
    def_bool $(shields_list_contains,hskbd45_right)
```

## config/west.yml
```yaml
manifest:
  remotes:
    - name: zmkfirmware
      url-base: https://github.com/zmkfirmware
  projects:
    - name: zmk
      remote: zmkfirmware
      revision: main        # v0.3-branch → main に変更
      import: app/west.yml
  self:
    path: config
```
